## main/Kconfig
```kconfig
menu "Static IP config"

    config USE_STATIC_IP_CONFIGURATION
        bool "Select between DHCP or Static IP"
        default n

    config DEFAULT_IP_ADDRESS
        depends on USE_STATIC_IP_CONFIGURATION
        string "Default IP to use in static mode"
        default "192.168.0.65"
    
    config DEFAULT_NETMASK
        depends on USE_STATIC_IP_CONFIGURATION
        string "Default netmask"
        default "255.255.255.0"

    config DEFAULT_GATEWAY
        depends on USE_STATIC_IP_CONFIGURATION
        string "Default gateway"
        default "192.168.0.1"
endmenu

menu "mDNS config"

    config USE_MDNS_CONFIG
        bool "Active mdns to find IP"
        default y
            help
              If enabled, the dns configuration will add a configured hostname
              in the local network e.g. espressi.local
    
    config SAME_LWIP_HOSTNAME
        depends on USE_MDNS_CONFIG
        bool "Use the same DNS hostname of the lwip?"
        default y
            help
              If desabled, you can configure your on dns hostname

    config MDNS_HOSTNAME
        depends on USE_MDNS_CONFIG && !SAME_LWIP_HOSTNAME
        string "Custom mdns hostname"
        default "esp32"

    config MDNS_INSTANCENAME
        depends on USE_MDNS_CONFIG && !SAME_LWIP_HOSTNAME
        string "Custom mdns instance name"
        default "esp32"



endmenu
```
